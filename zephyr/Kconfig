## zephyr/Kconfig
```kconfig
# GxEPD2 Kconfig - Just Select Your Display!
# All 37 display drivers available - uncomment ONE line

menuconfig GXEPD2
    bool "GxEPD2 E-Paper Display Library"
    depends on SPI && GPIO
    select CPP
    help
      GxEPD2 library for e-paper displays on Zephyr RTOS.
      Simply select your display model below and build!

if GXEPD2

module = GXEPD2
module-str = gxepd2
source "subsys/logging/Kconfig.template.log_config"

#
# STEP 1: SELECT YOUR DISPLAY (Uncomment ONE)
# All original drivers from src/epd/ are available!
#

choice GXEPD2_DISPLAY
    prompt "Select Your Display Model"
    help
      Choose your e-paper display model. The driver will be automatically
      compiled and initialized. Just select and build!

# 1.02" - 1.54" Displays
config GXEPD2_102
    bool "1.02\" 128x80 - GxEPD2_102"
config GXEPD2_150_BN
    bool "1.50\" 200x200 - GxEPD2_150_BN"
config GXEPD2_154
    bool "1.54\" 200x200 - GxEPD2_154 (GDEP015OC1)"
config GXEPD2_154_D67
    bool "1.54\" 200x200 - GxEPD2_154_D67 (GDEH0154D67)"
config GXEPD2_154_M09
    bool "1.54\" 200x200 - GxEPD2_154_M09"
config GXEPD2_154_M10
    bool "1.54\" 200x200 - GxEPD2_154_M10"
config GXEPD2_154_T8
    bool "1.54\" 200x200 - GxEPD2_154_T8 (GDEW0154T8)"

# 2.13" Displays
config GXEPD2_213
    bool "2.13\" 250x122 - GxEPD2_213 (GDE0213B1)"
config GXEPD2_213_B72
    bool "2.13\" 250x122 - GxEPD2_213_B72 (GDEH0213B72)"
config GXEPD2_213_B73
    bool "2.13\" 250x122 - GxEPD2_213_B73 (GDEH0213B73)"
config GXEPD2_213_B74
    bool "2.13\" 250x122 - GxEPD2_213_B74 (GDEH0213B74)"
config GXEPD2_213_BN
    bool "2.13\" 250x122 - GxEPD2_213_BN"
config GXEPD2_213_M21
    bool "2.13\" 250x122 - GxEPD2_213_M21 (GDEW0213M21)"
config GXEPD2_213_T5D
    bool "2.13\" 250x122 - GxEPD2_213_T5D (GDEW0213T5D)"
config GXEPD2_213_flex
    bool "2.13\" 250x122 Flexible - GxEPD2_213_flex"

# 2.6" - 2.9" Displays
config GXEPD2_260
    bool "2.6\" 296x152 - GxEPD2_260 (GDEW026T0)"
config GXEPD2_260_M01
    bool "2.6\" 296x152 - GxEPD2_260_M01 (GDEW026M01)"
config GXEPD2_266_BN
    bool "2.66\" 296x152 - GxEPD2_266_BN"
config GXEPD2_270
    bool "2.7\" 264x176 - GxEPD2_270 (GDEW027W3)"
config GXEPD2_290
    bool "2.9\" 296x128 - GxEPD2_290 (GDEH029A1)"
config GXEPD2_290_T5
    bool "2.9\" 296x128 - GxEPD2_290_T5 (GDEW029T5)"
config GXEPD2_290_T5D
    bool "2.9\" 296x128 - GxEPD2_290_T5D (GDEW029T5D)"
config GXEPD2_290_T94
    bool "2.9\" 296x128 - GxEPD2_290_T94"
config GXEPD2_290_T94_V2
    bool "2.9\" 296x128 - GxEPD2_290_T94_V2"
config GXEPD2_290_M06
    bool "2.9\" 296x128 - GxEPD2_290_M06 (GDEW029M06)"
config GXEPD2_290_BS
    bool "2.9\" 296x128 - GxEPD2_290_BS"

# 3.7" - 4.2" Displays
config GXEPD2_371
    bool "3.7\" 416x240 - GxEPD2_371 (GDEW0371W7)"
config GXEPD2_420
    bool "4.2\" 400x300 - GxEPD2_420 (GDEW042T2)"
config GXEPD2_420_M01
    bool "4.2\" 400x300 - GxEPD2_420_M01"
config GXEPD2_420_M02
    bool "4.2\" 400x300 - GxEPD2_420_M02"
config GXEPD2_437
    bool "4.37\" 512x368 - GxEPD2_437"

# 5.65" - 5.83" Displays
config GXEPD2_565
    bool "5.65\" 600x448 - GxEPD2_565 (GDEW0565T15)"
config GXEPD2_583
    bool "5.83\" 648x480 - GxEPD2_583 (GDEW0583T7)"
config GXEPD2_583_T8
    bool "5.83\" 648x480 - GxEPD2_583_T8 (GDEW0583T8)"

# 7.5" Displays
config GXEPD2_750
    bool "7.5\" 800x480 - GxEPD2_750 (GDEW075T8)"
config GXEPD2_750_T7
    bool "7.5\" 800x480 - GxEPD2_750_T7 (GDEW075T7)"

# 11.6" Display
config GXEPD2_1160_T91
    bool "11.6\" 1304x984 - GxEPD2_1160_T91"

# 12.48" Display
config GXEPD2_1248
    bool "12.48\" 1304x984 - GxEPD2_1248"

endchoice

#
# STEP 2: BOARD CONFIGURATION (Optional - Auto-Detected)
#

choice GXEPD2_BOARD
    prompt "Development Board"
    default GXEPD2_BOARD_AUTO
    help
      Select your board or use auto-detection.

config GXEPD2_BOARD_AUTO
    bool "Auto-detect (nRF52840/5340/54L15)"
config GXEPD2_BOARD_NRF52840
    bool "nRF52840 DK"
config GXEPD2_BOARD_NRF5340
    bool "nRF5340 DK"
config GXEPD2_BOARD_NRF54L15
    bool "nRF54L15 DK"
config GXEPD2_BOARD_CUSTOM
    bool "Custom (use device tree overlay)"
endchoice

#
# STEP 3: OPTIONS
#

config GXEPD2_AUTO_INIT
    bool "Auto-initialize at boot"
    default y
    help
      Display is automatically initialized and ready to use in main().
      Call gxepd2_get_display() to get the instance.

config GXEPD2_SPI_FREQUENCY
    int "SPI frequency (Hz)"
    default 4000000
    range 1000000 8000000
    help
      SPI clock frequency. Most displays work at 4MHz.

config GXEPD2_INIT_PRIORITY
    int "Init priority"
    default 90
    help
      Must be higher than SPI/GPIO drivers (50-60).

endif # GXEPD2
```

## zephyr/dts/bindings/gooddisplay,gxepd2.yaml
```yaml
# Device tree binding for Good Display GxEPD2 E-Paper Displays
description: Good Display / Waveshare E-Paper Display (SPI interface)

compatible: "gooddisplay,gxepd2"

include: spi-device.yaml

properties:
  dc-gpios:
    type: phandle-array
    required: true
    description: |
      Data/Command GPIO pin. This pin is used to differentiate between
      command and data bytes sent to the display controller.

  reset-gpios:
    type: phandle-array
    required: true
    description: |
      Reset GPIO pin. This pin is used to reset the display controller.

  busy-gpios:
    type: phandle-array
    required: true
    description: |
      Busy GPIO pin. This pin indicates when the display controller is busy
      processing commands or refreshing the display.

  busy-level:
    type: int
    default: 1
    description: |
      Logic level of the busy signal when display is busy (0 or 1).
      Default is 1 (active high).

  busy-timeout-ms:
    type: int
    default: 30000
    description: |
      Maximum time to wait for the busy signal to clear, in milliseconds.
      Default is 30000ms (30 seconds).

  width:
    type: int
    required: true
    description: Display width in pixels

  height:
    type: int
    required: true
    description: Display height in pixels

  panel-type:
    type: string
    required: true
    description: |
      Panel type identifier. Examples:
      "GDEP015OC1" - 1.54" b/w (200x200)
      "GDEW0213T5D" - 2.13" b/w (250x122)
      "GDEW029T5" - 2.9" b/w (296x128)
      "GDEW042T2" - 4.2" b/w (400x300)
      "GDEW075T8" - 7.5" b/w (800x480)
      See GxEPD2.h for complete list of supported panels.
```
