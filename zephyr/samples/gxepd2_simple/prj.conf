## CMakeLists.txt
```
# CMakeLists.txt for GxEPD2 Simple Sample
# This sample demonstrates the simplest possible use of GxEPD2

cmake_minimum_required(VERSION 3.20.0)

find_package(Zephyr REQUIRED HINTS $ENV{ZEPHYR_BASE})
project(gxepd2_simple)

target_sources(app PRIVATE src/main.cpp)
```

## prj.conf
```kconfig
# ============================================
# GxEPD2 - ULTRA SIMPLE CONFIGURATION
# ============================================
#
# STEP 1: Uncomment YOUR display model (choose ONE)
# STEP 2: Build and flash
# That's it!
#
# All 37 original display drivers available!
# ============================================

# Enable library
CONFIG_GXEPD2=y

# ============================================
# SELECT YOUR DISPLAY (Uncomment ONE line)
# ============================================

# 1.02" - 1.54" Displays
# CONFIG_GXEPD2_102=y                # 1.02" 128x80
# CONFIG_GXEPD2_150_BN=y            # 1.50" 200x200
CONFIG_GXEPD2_154=y                 # 1.54" 200x200 ← DEFAULT
# CONFIG_GXEPD2_154_D67=y           # 1.54" 200x200 (D67 variant)
# CONFIG_GXEPD2_154_M09=y           # 1.54" 200x200 (M09)
# CONFIG_GXEPD2_154_M10=y           # 1.54" 200x200 (M10)
# CONFIG_GXEPD2_154_T8=y            # 1.54" 200x200 (T8)

# 2.13" Displays
# CONFIG_GXEPD2_213=y               # 2.13" 250x122
# CONFIG_GXEPD2_213_B72=y           # 2.13" 250x122 (B72)
# CONFIG_GXEPD2_213_B73=y           # 2.13" 250x122 (B73)
# CONFIG_GXEPD2_213_B74=y           # 2.13" 250x122 (B74)
# CONFIG_GXEPD2_213_BN=y            # 2.13" 250x122 (BN)
# CONFIG_GXEPD2_213_M21=y           # 2.13" 250x122 (M21)
# CONFIG_GXEPD2_213_T5D=y           # 2.13" 250x122 (T5D)
# CONFIG_GXEPD2_213_flex=y          # 2.13" Flexible

# 2.6" - 2.9" Displays
# CONFIG_GXEPD2_260=y               # 2.6" 296x152
# CONFIG_GXEPD2_260_M01=y           # 2.6" 296x152 (M01)
# CONFIG_GXEPD2_266_BN=y            # 2.66" 296x152
# CONFIG_GXEPD2_270=y               # 2.7" 264x176
# CONFIG_GXEPD2_290=y               # 2.9" 296x128
# CONFIG_GXEPD2_290_T5=y            # 2.9" 296x128 (T5)
# CONFIG_GXEPD2_290_T5D=y           # 2.9" 296x128 (T5D)
# CONFIG_GXEPD2_290_T94=y           # 2.9" 296x128 (T94)
# CONFIG_GXEPD2_290_T94_V2=y        # 2.9" 296x128 (T94 V2)
# CONFIG_GXEPD2_290_M06=y           # 2.9" 296x128 (M06)
# CONFIG_GXEPD2_290_BS=y            # 2.9" 296x128 (BS)

# 3.7" - 4.37" Displays
# CONFIG_GXEPD2_371=y               # 3.7" 416x240
# CONFIG_GXEPD2_420=y               # 4.2" 400x300
# CONFIG_GXEPD2_420_M01=y           # 4.2" 400x300 (M01)
# CONFIG_GXEPD2_420_M02=y           # 4.2" 400x300 (M02)
# CONFIG_GXEPD2_437=y               # 4.37" 512x368

# 5.65" - 5.83" Displays
# CONFIG_GXEPD2_565=y               # 5.65" 600x448
# CONFIG_GXEPD2_583=y               # 5.83" 648x480
# CONFIG_GXEPD2_583_T8=y            # 5.83" 648x480 (T8)

# 7.5" Displays
# CONFIG_GXEPD2_750=y               # 7.5" 800x480
# CONFIG_GXEPD2_750_T7=y            # 7.5" 800x480 (T7)

# Large Displays
# CONFIG_GXEPD2_1160_T91=y          # 11.6" 1304x984
# CONFIG_GXEPD2_1248=y              # 12.48" 1304x984

# ============================================
# BOARD & OPTIONS (Auto-configured)
# ============================================

CONFIG_GXEPD2_BOARD_AUTO=y          # Auto-detect board
CONFIG_GXEPD2_AUTO_INIT=y           # Auto-initialize

# ============================================
# REQUIRED SYSTEM CONFIG (Don't change)
# ============================================

CONFIG_SPI=y
CONFIG_GPIO=y
CONFIG_CPP=y
CONFIG_STD_CPP11=y
CONFIG_MAIN_STACK_SIZE=4096

# Logging
CONFIG_LOG=y
CONFIG_GXEPD2_LOG_LEVEL_INF=y
```

## src/main.cpp
```c
/**
 * @file main.cpp
 * @brief Super Simple GxEPD2 Example - Minimal Code!
 *
 * This example shows the absolute simplest way to use GxEPD2 on Zephyr.
 * Just configure prj.conf and run - no device tree editing needed!
 *
 * Build:
 *   west build -b nrf52840dk_nrf52840
 *   west flash
 */

#include <zephyr/kernel.h>
#include "gxepd2_config.h"

/* Simple test pattern - creates a border and diagonal line */
void draw_test_pattern(GxEPD2_EPD *display)
{
    uint16_t width = display->WIDTH;
    uint16_t height = display->HEIGHT;

    printk("Drawing test pattern on %dx%d display...\n", width, height);

    /* Clear display to white */
    display->clearScreen(0xFF);

    /* For a real application, you would:
     * 1. Create a framebuffer
     * 2. Draw your content to the framebuffer
     * 3. Call display->writeImage(framebuffer, 0, 0, width, height)
     * 4. Call display->refresh()
     */

    printk("Test pattern complete!\n");
}

int main(void)
{
    printk("\n");
    printk("========================================\n");
    printk("  GxEPD2 Simple Example\n");
    printk("========================================\n\n");

    /* Print configuration - shows what was auto-configured */
    gxepd2_print_config();

    /* Get the display instance (auto-initialized if CONFIG_GXEPD2_AUTO_INIT=y) */
    GxEPD2_EPD *display = gxepd2_get_display();

    if (!display) {
        printk("ERROR: Display not initialized!\n");
        printk("Make sure CONFIG_GXEPD2_AUTO_INIT=y in prj.conf\n");
        return -1;
    }

    printk("SUCCESS! Display is ready to use.\n\n");

    /* Draw test pattern */
    draw_test_pattern(display);

    /* Power off display to save power and preserve image */
    display->powerOff();

    printk("\nNext steps:\n");
    printk("  1. Create a framebuffer for your display size\n");
    printk("  2. Draw to the framebuffer\n");
    printk("  3. Use display->writeImage() to send to display\n");
    printk("  4. Use display->refresh() to update the screen\n");
    printk("  5. Call display->powerOff() when done\n");

    /* Keep application running */
    while (1) {
        k_sleep(K_SECONDS(10));
    }

    return 0;
}
```
